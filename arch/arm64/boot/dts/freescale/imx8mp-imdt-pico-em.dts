// SPDX-License-Identifier: (GPL-2.0+ OR MIT)
/*
 * Copyright 2019 NXP
 * Copyright 2025 IMD Technologies
 */

/dts-v1/;

#include "imx8mp-imdt-pico.dtsi"

/ {
	model = "IMD Technologies Pico-EM Board";
	compatible = "imdt,imx8mp-imdt-pico-em", "fsl,imx8mp";
};

