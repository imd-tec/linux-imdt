## Documentation/devicetree/bindings/iio/chemical/bme688.txt
```
Bosch Sensortec BME688 pressure/temperature/humidity/voc sensors

Required properties:
- compatible: must be "bosch,bme688"

Example:

bme688@76 {
          compatible = "bosch,bme688";
          reg = <0x76>;
};
```

## drivers/iio/imu/bmx160/Kconfig
```kconfig
# SPDX-License-Identifier: GPL-2.0-only
#
# BMX160 IMU driver
#

config BMX160
	tristate
	select IIO_BUFFER
	select IIO_TRIGGERED_BUFFER

config BMX160_I2C
	tristate "Bosch BMX160 I2C driver"
	depends on I2C
	select BMX160
	select REGMAP_I2C
	help
	  If you say yes here you get support for BMX160 IMU on I2C with
	  accelerometer, gyroscope and magnetometer.

	  This driver can also be built as a module. If so, the module will be
	  called bmx160_i2c.

config BMX160_SPI
	tristate "Bosch BMX160 SPI driver"
	depends on SPI
	select BMX160
	select REGMAP_SPI
	help
	  If you say yes here you get support for BMX160 IMU on SPI with
	  accelerometer, gyroscope and magnetometer.

	  This driver can also be built as a module. If so, the module will be
	  called bmx160_spi.
```
